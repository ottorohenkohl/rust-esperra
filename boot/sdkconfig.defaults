## boot/sdkconfig.defaults
```kconfig
CONFIG_BOOTLOADER_APP_ROLLBACK_ENABLE=y
CONFIG_PARTITION_TABLE_CUSTOM=y
CONFIG_PARTITION_TABLE_CUSTOM_FILENAME="../res/partitions.csv"
CONFIG_PARTITION_TABLE_FILENAME="../res/partitions.csv"
CONFIG_ESPTOOLPY_FLASHSIZE_8MB=y
```
